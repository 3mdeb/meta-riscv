## conf/distro/riscv-base.conf
```bitbake
require conf/distro/poky.conf

INHERIT += "uninative"

DISTRO_FEATURES_append = " \
    largefile \
    opengl \
    ptest \
    multiarch \
    wayland \
    pam \
    systemd \
"

DISTRO_FEATURES_BACKFILL_CONSIDERED += "sysvinit"
VIRTUAL-RUNTIME_init_manager = "systemd"
HOSTTOOLS_NONFATAL_append = " ssh"
```
